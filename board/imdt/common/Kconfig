## board/imdt/common/Kconfig
```kconfig
config IMDT_PICO_COMMON
	bool "Common functions for IMDT's Pico boards"
	default y
	help
	  Include the common functions for IMDT's Pico boards
config IMDT_PICO_AUTO_DDR_SIZE_DETECTION
	bool "Enable IMDT Pico DDR version detection"
	default y
	help
	  Enable the DDR Size detection for IMDT Pico boards using  Ver resistors.
	  This is used to determine the specific board configuration and memory settings.
	  If this is false the board will use the DDR size index defined in IMDT_PICO_FORCE_DDR_SIZE
config IMDT_PICO_FORCE_DDR_SIZE_INDEX
	int "Force DDR size for the IMDT Pico boards"
	default 0
	help
	  Force the DDR size to a specific index value. This is useful for testing
	  purposes or when the board's memory configuration is known and fixed.
	  0 = 1GB 
	  1 = 2GB 
	  2 = 4GB 
      3 = 6GB
	  4 = 8GB
```

## board/imdt/imx8mp-pico/Kconfig
```kconfig
if TARGET_IMX8MP_IMDT_PICO

config SYS_BOARD
	default "imx8mp-pico"

config SYS_VENDOR
	default "imdt"

config SYS_CONFIG_NAME
	default "imx8mp-imdt-pico"

config IMX_CONFIG
	default "board/freescale/imx8mp_evk/imximage-8mp-lpddr4.cfg"

config ADD_OVERLAYS
    string "Additional DT overlays to apply after board_name check"
    help
      Space-separated list of .dtbo overlay files to apply
      after the base DTB and optional board_name-specific overlays.

config ENABLE_FDT_FIXUP_MEMORY_BANKS
    bool "Enable FDT memory bank fixup"
    default y
    help
      If enabled (default), memory bank fixups will be applied
      to the device tree at boot. Disable this if your memory
      layout is static and already defined in the DTB.
source "board/imdt/common/Kconfig"

endif
```
