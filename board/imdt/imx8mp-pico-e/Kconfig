## board/imdt/imx8mp-pico-e/Kconfig
```kconfig
if TARGET_IMX8MP_IMDT_PICO_E

config SYS_BOARD
	default "imx8mp-pico-e"

config SYS_VENDOR
	default "imdt"

config SYS_CONFIG_NAME
	default "imx8mp-imdt-pico-e"

source "board/freescale/common/Kconfig"
source "board/imdt/common/Kconfig"

endif
```

## board/imdt/imx8mp-pico-em/Kconfig
```kconfig
if TARGET_IMX8MP_IMDT_PICO_EM

config SYS_BOARD
	default "imx8mp-pico-em"

config SYS_VENDOR
	default "imdt"

config SYS_CONFIG_NAME
	default "imx8mp-imdt-pico-em"

source "board/freescale/common/Kconfig"
source "board/imdt/common/Kconfig"

endif
```

## board/imdt/imx8mp-pico-v2/Kconfig
```kconfig
if TARGET_IMX8MP_IMDT_PICO_V2

config SYS_BOARD
	default "imx8mp-pico-v2"

config SYS_VENDOR
	default "imdt"

config SYS_CONFIG_NAME
	default "imx8mp-imdt-pico-v2"

source "board/freescale/common/Kconfig"

endif
```

## board/imdt/imx8mp-pico-v3/Kconfig
```kconfig
#
# IM-PCA-0003
#

if TARGET_IMX8MP_IMDT_PICO_V3

config SYS_BOARD
	default "imx8mp-pico-v3"

config SYS_VENDOR
	default "imdt"

config SYS_CONFIG_NAME
	default "imx8mp-imdt-pico-v3"

source "board/freescale/common/Kconfig"
source "board/imdt/common/Kconfig"

endif

#
# IM-PCA-0004
#

if TARGET_IMX8MP_IMDT_PICO_V3_0004

config SYS_BOARD
	default "imx8mp-pico-v3"

config SYS_VENDOR
	default "imdt"

config SYS_CONFIG_NAME
	default "imx8mp-imdt-pico-v3-0004"

source "board/freescale/common/Kconfig"
source "board/imdt/common/Kconfig"

endif
```

## board/imdt/imx8mp-picoevk/Kconfig
```kconfig
if TARGET_IMX8MP_IMDT_PICOEVK

config SYS_BOARD
	default "imx8mp-picoevk"

config SYS_VENDOR
	default "imdt"

config SYS_CONFIG_NAME
	default "imx8mp-imdt-picoevk"

source "board/freescale/common/Kconfig"

endif
```

## board/imdt/imx8mp-uevk-2g/Kconfig
```kconfig
if TARGET_IMX8MP_IMDT_UEVK_2G

config SYS_BOARD
	default "imx8mp-uevk-2g"

config SYS_VENDOR
	default "imdt"

config SYS_CONFIG_NAME
	default "imx8mp-imdt-uevk-2g"

source "board/freescale/common/Kconfig"

endif
```
